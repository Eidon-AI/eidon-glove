## firmware/main/Kconfig.projbuild
```kconfig
menu "Eidon Device Configuration"
    config EXAMPLE_SSP_ENABLED
        bool "Secure Simple Pairing"
        depends on BT_CLASSIC_ENABLED
        default y
        help
            This enables the Secure Simple Pairing. If disable this option,
            Bluedroid will only support Legacy Pairing

    choice EXAMPLE_HID_DEVICE_ROLE
        prompt "Eidon Device Type"
        default EXAMPLE_TRACKER_ENABLE
        help
            Select the type of Eidon device
            - Tracker: Basic orientation sensor
            - Glove: Extended sensor array (future)

        config EXAMPLE_TRACKER_ENABLE
            bool "Eidon Tracker"
            help
                Basic orientation tracking device with IMU sensor

        config EXAMPLE_GLOVE_ENABLE
            bool "Eidon Glove"
            help
                Extended sensor array device (currently same as Tracker)
    endchoice

    config HID_DEVICE_ROLE
        int
        default 1 if EXAMPLE_TRACKER_ENABLE
        default 2 if EXAMPLE_GLOVE_ENABLE

    config IMU_DEBUG_LOGGING
        bool "Enable IMU debug logging"
        default n
        help
            Enable detailed debug logging for IMU communication.
            This will show SPI/I2C transactions, INT pin status, and sensor events.
endmenu
```

## firmware/sdkconfig.defaults
```kconfig
CONFIG_BT_ENABLED=y
CONFIG_BTDM_CTRL_MODE_BTDM=y
CONFIG_BT_BLUEDROID_ENABLED=y
CONFIG_BT_CLASSIC_ENABLED=y
CONFIG_BT_BLE_ENABLED=y
CONFIG_BT_HID_ENABLED=y
CONFIG_BT_HID_DEVICE_ENABLED=y
CONFIG_BT_SDP_COMMON_ENABLED=y
CONFIG_BT_BLE_42_FEATURES_SUPPORTED=y
CONFIG_PARTITION_TABLE_SINGLE_APP_LARGE=y

# BNO08x GPIO Configuration for Seeed XIAO ESP32-C6
CONFIG_ESP32_BNO08X_GPIO_HINT=22
CONFIG_ESP32_BNO08X_GPIO_RST=23
CONFIG_ESP32_BNO08X_GPIO_CS=17
CONFIG_ESP32_BNO08X_GPIO_SCL=19
CONFIG_ESP32_BNO08X_GPIO_DI=18
CONFIG_ESP32_BNO08X_GPIO_SDA=20
CONFIG_ESP32_BNO08X_GPIO_WAKE=2

# SPI Configuration
CONFIG_ESP32_BNO08x_SPI_HOST=2
CONFIG_ESP32_BNO08X_SCL_SPEED_HZ=3000000
CONFIG_ESP32_BNO08X_SPI_INTR_CPU_AFFINITY=0

# Task configuration
CONFIG_ESP32_BNO08X_DATA_PROC_TASK_SZ=4096

# Debug
CONFIG_ESP32_BNO08x_DEBUG_STATEMENTS=y
CONFIG_BT_ENABLED=n
```
